## conf/layer.conf
```bitbake
# We have a conf and classes directory, add to BBPATH
BBPATH .= ":${LAYERDIR}"

# We have a recipes-* directories, add to BBFILES
BBFILES += "${LAYERDIR}/recipes-*/*/*.bb \
	${LAYERDIR}/recipes-*/*/*.bbappend"

BBFILE_COLLECTIONS += "meta-st-x-linux-tpm"
BBFILE_PATTERN_meta-st-x-linux-tpm := "^${LAYERDIR}/"
BBFILE_PRIORITY_meta-st-x-linux-tpm = "7"

# Adding TPM2 in DISTRO_FEATURES
DISTRO_FEATURES:append = " tpm2 \
						security \
"

# Adding some libtss2 and tpm2 recipes manually
IMAGE_INSTALL:append = " \
  tpm2-tools \
  tpm2-openssl \
  libtss2 \
  libtss2-tcti-device \
  libtss2-tcti-mssim \
  tpm2-abrmd \
  tpm2-totp \
  tpm2-tss \
  tpm2-tss-engine \
  tpm2-tss-engine-dev \ 
"

LAYERSERIES_COMPAT_meta-st-x-linux-tpm = "scarthgap"

# OpenSTLinux compatibility version
ST_OSTL_COMPATIBILITY_VERSION_meta-st-x-linux-tpm = "6.0 6.1"
```
